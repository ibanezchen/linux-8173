## Documentation/devicetree/bindings/soc/mediatek/infracfg.txt
```
MediaTek infracfg Controller

The infracfg controller contains miscellaneous registers for controlling
clocks, resets and bus settings.

Required properties:
- compatible: must be one of:
	mediatek,mt8135-infracfg
	mediatek,mt8173-infracfg
- reg: Address range for the infracfg controller

Example:

	infracfg: infracfg@10003000 {
		#reset-cells = <1>;
		#clock-cells = <1>;
		compatible = "mediatek,mt8135-infracfg";
		reg = <0 0x10003000 0 0x1000>;
	};
```

## Documentation/devicetree/bindings/soc/mediatek/pericfg.txt
```
MediaTek pericfg Controller

The pericfg controller contains miscellaneous registers for controlling
clocks, resets and bus settings.

Required properties:
- compatible: must be one of:
	mediatek,mt8135-pericfg
	mediatek,mt8173-pericfg
- reg: Address range for the pericfg controller

Example:

	pericfg: pericfg@10003000 {
		#reset-cells = <1>;
		#clock-cells = <1>;
		compatible = "mediatek,mt8135-pericfg";
		reg = <0 0x10003000 0 0x1000>;
	};
```

## drivers/soc/mediatek/Kconfig
```kconfig
#
# MediaTek SoC drivers
#
config MTK_INFRACFG
	tristate "MediaTek infracfg controller support"
	depends on ARCH_MEDIATEK || COMPILE_TEST
	select REGMAP
	help
	  The MediaTek infracfg controller found on MT8135 and MT8173 SoCs
	  contains several miscellaneous registers for clock, reset and bus
	  settings. Say yes here if you want to run your kernel on one of these
	  SoCs.

config MTK_PERICFG
	tristate "MediaTek pericfg controller support"
	depends on ARCH_MEDIATEK || COMPILE_TEST
	select REGMAP
	help
	  The MediaTek pericfg controller found on MT8135 and MT8173 SoCs
	  contains several miscellaneous registers for clock, reset and bus
	  settings. Say yes here if you want to run your kernel on one of these
	  SoCs.

config MTK_PMIC_WRAP
	tristate "MediaTek PMIC Wrapper Support"
	depends on ARCH_MEDIATEK
	select REGMAP
	help
	  Say yes here to add support for MediaTek PMIC Wrapper found
	  on the MT8135 and MT8173 SoCs. The PMIC wrapper is a proprietary
	  hardware to connect the PMIC.
```
